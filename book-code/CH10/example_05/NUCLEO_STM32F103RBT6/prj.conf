## CMakeLists.txt
```
cmake_minimum_required(VERSION 3.28.0)

find_package(Zephyr REQUIRED HINTS $ENV{ZEPHYR_BASE})
project(zephyr_rust_led)

target_sources(app PRIVATE src/main.c)
target_include_directories(app PRIVATE
    ${CMAKE_CURRENT_SOURCE_DIR}/include
)

set(RUST_ARCHIVE
    "${CMAKE_CURRENT_SOURCE_DIR}/rust/led_logic/target/thumbv7m-none-eabi/release/libled_logic.a"
)

if(NOT EXISTS "${RUST_ARCHIVE}")
    message(FATAL_ERROR
        "Rust library missing: run the Cargo build command first."
    )
endif()

add_library(rust_led STATIC IMPORTED GLOBAL)
set_target_properties(rust_led PROPERTIES
    IMPORTED_LOCATION "${RUST_ARCHIVE}"
)

target_link_libraries(app PRIVATE rust_led)
```

## prj.conf
```kconfig
CONFIG_GPIO=y
CONFIG_MAIN_STACK_SIZE=2048
```

## src/main.c
```c
#include <stdint.h>
#include <zephyr/kernel.h>
#include <zephyr/drivers/gpio.h>
#include "led_logic.h"

/* Obtain the board's LED pin and its active-level setting. */
static const struct gpio_dt_spec led =
    GPIO_DT_SPEC_GET(DT_ALIAS(led0), gpios);

int main(void)
{
    if (!gpio_is_ready_dt(&led)) {
        return 0;
    }

    int err = gpio_pin_configure_dt(&led, GPIO_OUTPUT_INACTIVE);
    if (err < 0) {
        return 0;
    }

    uint32_t step = 0;

    for (;;) {
        /* This call executes Rust within the current Zephyr thread. */
        uint32_t on = led_pattern(step);

        err = gpio_pin_set_dt(&led, on != 0);
        if (err < 0) {
            return 0;
        }

        step = (step + 1U) % 10U;

        /* Suspend this thread before requesting the next pattern step. */
        k_msleep(200);
    }
}
```

## include/led_logic.h
```c
#include <stdarg.h>
#include <stdbool.h>
#include <stdint.h>
#include <stdlib.h>

/**
 * Return 1 for LED on, or 0 for LED off.
 */
uint32_t led_pattern(uint32_t step);
```
